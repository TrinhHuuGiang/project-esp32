## ESPIDF/Code/_0200_i2c_rtc_DS3231/components/_peripherals_handle/Kconfig.projbuild
```kconfig
menu "DEV_____PERIPHERALS"

config I2C_MASTER_PORT_NUMBER
    int "I2C port for master mode"
    default 0
    range 0 1
    help
        esp32 support 2 port, choose 0 or 1

config I2C_MASTER_PORT_CLOCK
    int "I2C clock for master port"
    default 100000
    range 100000 1000000
    help
        I2C maximum frequency 1Mhz, standard 100kHz

config I2C_MASTER_SDA_PIN
    int "I2C master sda pin"
    default 21
    help
        esp32 default SDA pin 21

config I2C_MASTER_SDA_PULLUP_EN
    bool "I2C master sda pull-up enable"
    default y
    help
        pull-up SDA if you need  

config I2C_MASTER_SCL_PIN
    int "I2C master scl pin"
    default 22
    help
        esp32 default SCL pin 22

config I2C_MASTER_SCL_PULLUP_EN
    bool "I2C master scl pull-up enable"
    default y
    help
        pull-up SCL if you need  

endmenu
```

## ESPIDF/Code/_0200_i2c_rtc_DS3231/main/Kconfig.projbuild
```kconfig
menu "DEV_____Main Configuration"

config DEBUG_ENABLE
    bool "Enable serial debug printing"
    default y

endmenu
```

## ESPIDF/Code/_0500_wifi_connect_to_mqtt/components/_peripherals_handle/Kconfig.projbuild
```kconfig
menu "DEV_____Peripherals_internal"

config I2C_MASTER_PORT_NUMBER
    int "I2C port for master mode"
    default 0
    range 0 1
    help
        esp32 support 2 port, choose 0 (port0) or 1 (port1)

config I2C_MASTER_PORT_CLOCK
    int "I2C clock for master port"
    default 100000
    range 100000 1000000
    help
        I2C maximum frequency 1Mhz, standard 100kHz

config I2C_MASTER_SDA_PIN
    int "I2C master sda pin"
    default 21
    help
        esp32 default SDA pin 21

config I2C_MASTER_SDA_PULLUP_EN
    int "I2C master sda pull-up enable"
    default 1
    range 0 1
    help
        pull-up SDA (input 1) if you need  

config I2C_MASTER_SCL_PIN
    int "I2C master scl pin"
    default 22
    help
        esp32 default SCL pin 22

config I2C_MASTER_SCL_PULLUP_EN
    int "I2C master scl pull-up enable"
    default 1
    range 0 1
    help
        pull-up SCL (input 1) if you need  



config SPI_MASTER_PORT_NUMBER
    int "choose SPI peripherals" 
    default 2
    range 1 2
    help
        SPI2 (1) and SPI3 (2) are general purpose SPI controllers, sometimes referred to as HSPI and VSPI

config SPI_MASTER_MOSI_PIN
    int "SPI master mosi pin"
    default 23
    help
        default mosi of VSPI on esp32 is GPIO23

config SPI_MASTER_MISO_PIN
    int "SPI master miso pin"
    default 19
    help
        default MISO of VSPI on esp32 is GPIO19

config SPI_MASTER_SCLK_PIN
    int "SPI master sclk pin"
    default 18
    help
        default MISO of VSPI on esp32 is GPIO18

config SPI_MASTER_LIMIT_FREQ_GPIO_MATRIX 
    int "SPI master limit maximum frequency"
    default 10000000
    range 1000000 27000000
    help
        set maximum to warn admin limit device frequency.
        When input delay time > 100ns, maximum frequency should < 8Mhz.
        When input delay time = 0ns, maximum frequency is 26,67Mhz


choice ESP_WIFI_SCAN_AUTH_MODE_THRESHOLD
    prompt "WiFi Scan auth mode threshold"
    default ESP_WIFI_AUTH_OPEN
    help
        The weakest authmode to accept in the scan mode.

    config ESP_WIFI_AUTH_OPEN
        bool "OPEN"
    config ESP_WIFI_AUTH_WEP
        bool "WEP"
    config ESP_WIFI_AUTH_WPA_PSK
        bool "WPA PSK"
    config ESP_WIFI_AUTH_WPA2_PSK
        bool "WPA2 PSK"
    config ESP_WIFI_AUTH_WPA_WPA2_PSK
        bool "WPA/WPA2 PSK"
    config ESP_WIFI_AUTH_WPA3_PSK
        bool "WPA3 PSK"
    config ESP_WIFI_AUTH_WPA2_WPA3_PSK
        bool "WPA2/WPA3 PSK"
    config ESP_WIFI_AUTH_WAPI_PSK
        bool "WAPI PSK"
endchoice

endmenu
```

## ESPIDF/Code/_0600_refactor_project/components/_2_2_external_periphs/uart_rs485/Kconfig
```kconfig
menu "DEV_____Peripherals_external_RS485_uart_differential_transmission"


endmenu
```

## ESPIDF/Code/_0700_final_project/components/_2_2_external_periphs/gpio_74HC165/Kconfig
```kconfig
menu "DEV_____Peripherals_external_74HC165_input_logic"

config GPIO_74HC165_LATCH_PIN
    int "generate signal for latch"
    default 32
    help
        GPIO output pwm, using control latch 74HC165

config GPIO_74HC165_CLOCK_PIN
    int "generate signal for clock"
    default 33
    help
        GPIO output pwm, using like clock 74HC165

config GPIO_74HC165_DATA_SHIFT_IN
    int "input gpio get shift in data"
    default 35
    help
        GPIO input, get signal shift in by series 74hc165

endmenu
```

## ESPIDF/Code/_0700_final_project/components/_2_2_external_periphs/gpio_74HC595/Kconfig
```kconfig
menu "DEV_____Peripherals_external_74HC565_output_logic"

config GPIO_74HC595_LATCH_PIN
    int "generate signal for latch"
    default 5
    help
        GPIO CS SPI, using control latch 74HC565


endmenu
```

## ESPIDF/Code/_0700_final_project/components/_2_2_external_periphs/i2s_max98357/Kconfig
```kconfig
menu "DEV_____Peripherals_external_MAX98537_i2s_sound"


config I2S_MAX98357_SD_PIN
    int "shut down pin control output MAX98357 amplifier"
    default 17
    help
        GPIO 17 for SD pin of MAX98357


endmenu
```

## ESPIDF/Code/_0700_final_project/components/_4_1_internal_drivers/Kconfig
```kconfig
menu "DEV_____Driver_internal"

config WID_REALTIME_TIMEZONE
    string "Timezone string (TZ)"
    default "ICT-7"
    help
        POSIX-style timezone string.
        Use "ICT-7" for Vietnam (UTC+7), "GMT-8" for UTC+8, etc.

config WID_REALTIME_SERVER
    string "NTP server address"
    default "pool.ntp.org"
    help
        NTP server to synchronize time.

config WID_REALTIME_SERVER
    string "NTP server address"
    default "pool.ntp.org"
    help
        NTP server to synchronize time.


choice WID_DISPLAY_SSD1306_ADDR
    prompt "display SSD1306 I2C Address"
    default WID_DISPLAY_SSD1306_ADDR_3C
    help
        Select the I2C address of the SSD1306 display
        for display driver. Usually 0x3C or 0x3D.

config WID_DISPLAY_SSD1306_ADDR_3C
    bool "0x3C"

config WID_DISPLAY_SSD1306_ADDR_3D
    bool "0x3D"
endchoice



endmenu
```
